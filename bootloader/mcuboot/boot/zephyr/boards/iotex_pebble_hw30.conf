## bootloader/mcuboot/boot/zephyr/boards/iotex_pebble_hw30.conf
```kconfig
# Disable Zephyr console
CONFIG_CONSOLE=n
CONFIG_CONSOLE_HANDLER=n
CONFIG_UART_CONSOLE=n

# Disable Flash protection
#CONFIG_FPROTECT=y

# MCUBoot settings
CONFIG_BOOT_MAX_IMG_SECTORS=256

# MCUboot serial recovery
CONFIG_MCUBOOT_SERIAL=y
CONFIG_BOOT_SERIAL_DETECT_PORT="GPIO_0"
CONFIG_BOOT_SERIAL_DETECT_PIN=15
CONFIG_BOOT_SERIAL_DETECT_PIN_VAL=0
CONFIG_BOOT_IOTEX_BOARD_VERSION=3
CONFIG_NRFX_TWIM=y
CONFIG_NRFX_TWIM2=y
CONFIG_SIZE_OPTIMIZATIONS=y
```

## nrf/applications/asset_tracker/src/mqtt/Kconfig
```kconfig
#
# Copyright (c) 2019 Nordic Semiconductor ASA
#
# SPDX-License-Identifier: LicenseRef-BSD-5-Clause-Nordic
#

menu "MQTT_CONFIG"

config DEBUG_MQTT_CONFIG
	bool "Enable MQTT Configure Debug"
	default n

config MQTT_CONFIG_BULK_UPLOAD
	bool "Enable bulk upload"
	default n

config MQTT_CONFIG_DATA_CHANNEL
	hex "Sampling data channel"
	default 0x1ff7

config MQTT_CONFIG_UPLOAD_PERIOD
	int "Data upload period"
	depends on !MQTT_CONFIG_BULK_UPLOAD
	default 30

config MQTT_CONFIG_SAMPLING_COUNT
	int "Bulk upload sampling count"
	depends on MQTT_CONFIG_BULK_UPLOAD
	default 100

config MQTT_CONFIG_SAMPLING_FREQUENCY
	int "Bulk upload sampling frequency"
	depends on MQTT_CONFIG_BULK_UPLOAD
	default 10


module = MQTT_CONFIG
module-str = MQTT_CONFIG
source "${ZEPHYR_BASE}/subsys/logging/Kconfig.template.log_config"

endmenu
```

## nrf/applications/asset_tracker/src/ota/Kconfig
```kconfig
#
# Copyright (c) 2019 Nordic Semiconductor ASA
#
# SPDX-License-Identifier: LicenseRef-BSD-5-Clause-Nordic
#

menu "IOTEX  HTTP application update"

config DOWNLOAD_HOST
	string "Download host name"

config DOWNLOAD_FILE
	string "The file to download"

config APPLICATION_VERSION
	int "Application version"
	default 1

config USE_HTTPS
	bool
	prompt "Use HTTPS for download"

endmenu
```

## nrf/applications/asset_tracker/src/unittest/Kconfig
```kconfig
#
# Copyright (c) 2019 Nordic Semiconductor ASA
#
# SPDX-License-Identifier: LicenseRef-BSD-5-Clause-Nordic
#

menu "Unittest"

config UNITTEST
	bool "Enable Unittest"

config NVS_UNITTEST
	bool "Test NVS Local storage"
	depends on UNITTEST
	default n

config NANOPB_UNITTEST
	bool "Test nanopb protobuf encode/decode"
	depends on UNITTEST
	default n

config MQTT_UNITTEST
	bool "Test MQTT"
	depends on UNITTEST
	default n

module = UNITTEST
module-str = Unittest
source "${ZEPHYR_BASE}/subsys/logging/Kconfig.template.log_config"

endmenu
```

## nrf/tests/unity/Kconfig
```kconfig
#
# Copyright (c) 2019 Nordic Semiconductor
#
# SPDX-License-Identifier: LicenseRef-BSD-5-Clause-Nordic
#

config UNITY
	bool "Use Unity test framework"
```
